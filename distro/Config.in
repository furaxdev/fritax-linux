## distro/Config.in
```kconfig
source "$BR2_EXTERNAL_FRITAX_LINUX_PATH/package/fritax-branding/Config.in"
source "$BR2_EXTERNAL_FRITAX_LINUX_PATH/package/fritax-shell/Config.in"
source "$BR2_EXTERNAL_FRITAX_LINUX_PATH/package/fritax-files/Config.in"
source "$BR2_EXTERNAL_FRITAX_LINUX_PATH/package/fritax-terminal/Config.in"
source "$BR2_EXTERNAL_FRITAX_LINUX_PATH/package/fritax-tunnel/Config.in"
source "$BR2_EXTERNAL_FRITAX_LINUX_PATH/package/fritax-login/Config.in"
source "$BR2_EXTERNAL_FRITAX_LINUX_PATH/package/fritax-antivirus/Config.in"
source "$BR2_EXTERNAL_FRITAX_LINUX_PATH/package/fritax-calculatrice/Config.in"
source "$BR2_EXTERNAL_FRITAX_LINUX_PATH/package/fritax-moniteur/Config.in"
```

## distro/package/fritax-antivirus/Config.in
```kconfig
config BR2_PACKAGE_FRITAX_ANTIVIRUS
	bool "fritax-antivirus"
	help
	  L'antivirus de Fritax Linux : scanner de signatures ecrit a la main, avec
	  le fichier de test standard EICAR. La quarantaine ne supprime jamais les fichiers.
```

## distro/package/fritax-branding/Config.in
```kconfig
config BR2_PACKAGE_FRITAX_BRANDING
	bool "fritax-branding"
	help
	  L'identite visuelle et les reglages de Fritax Linux :
	  os-release, message d'accueil, fond d'ecran, banniere de
	  demarrage et reglages systeme propres a la distribution.
```

## distro/package/fritax-calculatrice/Config.in
```kconfig
config BR2_PACKAGE_FRITAX_CALCULATRICE
	bool "fritax-calculatrice"
	help
	  La calculatrice de Fritax Linux : les quatre operations, le pourcentage
	  et l'historique, a la souris comme au clavier.
```

## distro/package/fritax-files/Config.in
```kconfig
config BR2_PACKAGE_FRITAX_FILES
	bool "fritax-files"
	help
	  Le gestionnaire de fichiers de Fritax Linux.
	  Ecrit a la main (aucune bibliotheque graphique) : moteur DRM/KMS
	  pour la distribution, moteur X11 pour les tests.
```

## distro/package/fritax-login/Config.in
```kconfig
config BR2_PACKAGE_FRITAX_LOGIN
	bool "fritax-login"
	help
	  Ecran de connexion de Fritax Linux : carte centree aux coins
	  lisses, deux champs, bouton "Se connecter". Apres une
	  connexion reussie il lance le bureau (fritax-shell).
	  Parle directement au materiel (DRM/KMS) : ni X11, ni Wayland.
```

## distro/package/fritax-moniteur/Config.in
```kconfig
config BR2_PACKAGE_FRITAX_MONITEUR
	bool "fritax-moniteur"
	help
	  Le moniteur systeme de Fritax Linux : processeur, memoire, swap, charge et
	  temps de fonctionnement, lus directement dans /proc.
```

## distro/package/fritax-shell/Config.in
```kconfig
config BR2_PACKAGE_FRITAX_SHELL
	bool "fritax-shell"
	help
	  Le bureau de Fritax Linux : barre flottante arrondie,
	  lanceur d'applications et horloge. Parle directement au
	  materiel (DRM/KMS) : ni serveur graphique, ni bibliotheque.
```

## distro/package/fritax-terminal/Config.in
```kconfig
config BR2_PACKAGE_FRITAX_TERMINAL
	bool "fritax-terminal"
	help
	  Le terminal maison de Fritax Linux. Deux variantes :
	  native (DRM/KMS, pour la distribution) et X11 (pour
	  tester depuis un bureau existant). Moteur VT100/xterm
	  ecrit de zero, police bitmap integree, aucune dependance.
```

## distro/package/fritax-tunnel/Config.in
```kconfig
config BR2_PACKAGE_FRITAX_TUNNEL
	bool "fritax-tunnel"
	help
	  Notre propre tunnel TCP avec mot de passe (relais, exposition
	  d'un service local, connexion). Permet d'atteindre un PC
	  derriere une box sans redirection de port. Ecrit de zero.
```
